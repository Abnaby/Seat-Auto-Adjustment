## Yocto Project Quick Start/LAB3_Graphics/conf/bblayers.conf
```bitbake
# POKY_BBLAYERS_CONF_VERSION is increased each time build/conf/bblayers.conf
# changes incompatibly
POKY_BBLAYERS_CONF_VERSION = "2"

BBPATH = "${TOPDIR}"
BBFILES ?= ""

BBLAYERS ?= " \
  /home/abnaby/yocto/poky/meta \
  /home/abnaby/yocto/poky/meta-poky \
  /home/abnaby/yocto/poky/meta-yocto-bsp \
  /home/abnaby/yocto/myLayers/meta-cpp \
  /home/abnaby/yocto/poky/custom_layers/meta-openembedded/meta-oe \
  /home/abnaby/yocto/poky/custom_layers/meta-openembedded/meta-python \
  /home/abnaby/yocto/poky/custom_layers/meta-openembedded/meta-networking \
  /home/abnaby/yocto/poky/custom_layers/meta-qt5 \
  /home/abnaby/yocto/myLayers/meta-py \
  /home/abnaby/yocto/myLayers/meta-graphics \
  /home/abnaby/yocto/myLayers/meta-shell \
  "
```

## Yocto Project Quick Start/Layers/meta-connectivity/conf/layer.conf
```bitbake
# We have a conf and classes directory, add to BBPATH
BBPATH .= ":${LAYERDIR}"

# We have recipes-* directories, add to BBFILES
BBFILES += "${LAYERDIR}/recipes-*/*/*.bb \
            ${LAYERDIR}/recipes-*/*/*.bbappend"

BBFILE_COLLECTIONS += "meta-connectivity"
BBFILE_PATTERN_meta-connectivity = "^${LAYERDIR}/"
BBFILE_PRIORITY_meta-connectivity = "6"

LAYERDEPENDS_meta-connectivity = "core"
LAYERSERIES_COMPAT_meta-connectivity = "kirkstone"
```

## Yocto Project Quick Start/Layers/meta-graphics/conf/layer.conf
```bitbake
# We have a conf and classes directory, add to BBPATH
BBPATH .= ":${LAYERDIR}"

# We have recipes-* directories, add to BBFILES
BBFILES += "${LAYERDIR}/recipes-*/*/*.bb \
            ${LAYERDIR}/recipes-*/*/*.bbappend"

BBFILE_COLLECTIONS += "meta-graphics"
BBFILE_PATTERN_meta-graphics = "^${LAYERDIR}/"
BBFILE_PRIORITY_meta-graphics = "6"

LAYERDEPENDS_meta-graphics = "core"
LAYERSERIES_COMPAT_meta-graphics = "kirkstone"
```

## Yocto Project Quick Start/Layers/meta-py/conf/layer.conf
```bitbake
# We have a conf and classes directory, add to BBPATH
BBPATH .= ":${LAYERDIR}"

# We have recipes-* directories, add to BBFILES
BBFILES += "${LAYERDIR}/recipes-*/*/*.bb \
            ${LAYERDIR}/recipes-*/*/*.bbappend"

BBFILE_COLLECTIONS += "meta-py"
BBFILE_PATTERN_meta-py = "^${LAYERDIR}/"
BBFILE_PRIORITY_meta-py = "6"

LAYERDEPENDS_meta-py = "core"
LAYERSERIES_COMPAT_meta-py = "kirkstone"
```

## rpi_projectBuild/conf/bblayers.conf
```bitbake
# POKY_BBLAYERS_CONF_VERSION is increased each time build/conf/bblayers.conf
# changes incompatibly
POKY_BBLAYERS_CONF_VERSION = "2"

BBPATH = "${TOPDIR}"
BBFILES ?= ""

BBLAYERS ?= " \
  /home/abnaby/yocto/poky/meta \
  /home/abnaby/yocto/poky/meta-poky \
  /home/abnaby/yocto/poky/meta-yocto-bsp \
  /home/abnaby/yocto/poky/custom_layers/meta-raspberrypi \
  /home/abnaby/yocto/poky/custom_layers/meta-qt5 \
  /home/abnaby/yocto/poky/custom_layers/meta-openembedded/meta-oe \
  /home/abnaby/yocto/poky/custom_layers/meta-openembedded/meta-python \
  /home/abnaby/yocto/poky/custom_layers/meta-openembedded/meta-networking \
  /home/abnaby/yocto/myLayers/meta-rpihw \
  /home/abnaby/yocto/myLayers/meta-shell \
  /home/abnaby/yocto/myLayers/meta-graphics \
      "
```

## rpi_projectBuild/myLayers/meta-rpihw/conf/layer.conf
```bitbake
# We have a conf and classes directory, add to BBPATH
BBPATH .= ":${LAYERDIR}"

# We have recipes-* directories, add to BBFILES
BBFILES += "${LAYERDIR}/recipes-*/*/*.bb \
            ${LAYERDIR}/recipes-*/*/*.bbappend"

BBFILE_COLLECTIONS += "meta-rpihw"
BBFILE_PATTERN_meta-rpihw = "^${LAYERDIR}/"
BBFILE_PRIORITY_meta-rpihw = "6"

LAYERDEPENDS_meta-rpihw = "core"
LAYERSERIES_COMPAT_meta-rpihw = "kirkstone"
```

## rpi_projectBuild/myLayers/meta-shell/conf/layer.conf
```bitbake
# We have a conf and classes directory, add to BBPATH
BBPATH .= ":${LAYERDIR}"

# We have recipes-* directories, add to BBFILES
BBFILES += "${LAYERDIR}/recipes-*/*/*.bb \
            ${LAYERDIR}/recipes-*/*/*.bbappend"

BBFILE_COLLECTIONS += "meta-shell"
BBFILE_PATTERN_meta-shell = "^${LAYERDIR}/"
BBFILE_PRIORITY_meta-shell = "6"

LAYERDEPENDS_meta-shell = "core"
LAYERSERIES_COMPAT_meta-shell = "kirkstone"
```
